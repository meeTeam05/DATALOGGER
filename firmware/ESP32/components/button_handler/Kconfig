## firmware/ESP32/components/button_handler/Kconfig
```kconfig
menu "Button Handler Configuration"

    config BUTTON_RELAY_GPIO
        int "Relay button GPIO pin number"
        range 0 39 if IDF_TARGET_ESP32
        range 0 46 if IDF_TARGET_ESP32S2
        range 0 48 if IDF_TARGET_ESP32S3
        range 0 21 if IDF_TARGET_ESP32C3 || IDF_TARGET_ESP32C2
        default 5 if IDF_TARGET_ESP32
        default 5 if IDF_TARGET_ESP32S2 || IDF_TARGET_ESP32S3
        default 5 if IDF_TARGET_ESP32C3 || IDF_TARGET_ESP32C2
        help
            GPIO pin for relay toggle button.
            Press to toggle relay ON/OFF.
            ESP32: Any GPIO (avoid 6-11, 34-39)
            Recommended: GPIO 0, 4, 5, 12-15, 25-27, 32-33

    config BUTTON_SINGLE_GPIO
        int "Single command button GPIO pin number"
        range 0 39 if IDF_TARGET_ESP32
        range 0 46 if IDF_TARGET_ESP32S2
        range 0 48 if IDF_TARGET_ESP32S3
        range 0 21 if IDF_TARGET_ESP32C3 || IDF_TARGET_ESP32C2
        default 25 if IDF_TARGET_ESP32
        default 25 if IDF_TARGET_ESP32S2 || IDF_TARGET_ESP32S3
        default 9 if IDF_TARGET_ESP32C3 || IDF_TARGET_ESP32C2
        help
            GPIO pin for SINGLE command button.
            Press to send SINGLE sensor read command to STM32.
            ESP32: Any GPIO (avoid 6-11, 34-39)
            Recommended: GPIO 0, 4, 5, 12-15, 25-27, 32-33

    config BUTTON_PERIODIC_GPIO
        int "Periodic toggle button GPIO pin number"
        range 0 39 if IDF_TARGET_ESP32
        range 0 46 if IDF_TARGET_ESP32S2
        range 0 48 if IDF_TARGET_ESP32S3
        range 0 21 if IDF_TARGET_ESP32C3 || IDF_TARGET_ESP32C2
        default 26 if IDF_TARGET_ESP32
        default 26 if IDF_TARGET_ESP32S2 || IDF_TARGET_ESP32S3
        default 10 if IDF_TARGET_ESP32C3 || IDF_TARGET_ESP32C2
        help
            GPIO pin for PERIODIC toggle button.
            Press to toggle periodic sensor reading ON/OFF.
            ESP32: Any GPIO (avoid 6-11, 34-39)
            Recommended: GPIO 0, 4, 5, 12-15, 25-27, 32-33

    config BUTTON_INTERVAL_GPIO
        int "Interval cycle button GPIO pin number"
        range 0 39 if IDF_TARGET_ESP32
        range 0 46 if IDF_TARGET_ESP32S2
        range 0 48 if IDF_TARGET_ESP32S3
        range 0 21 if IDF_TARGET_ESP32C3 || IDF_TARGET_ESP32C2
        default 4 if IDF_TARGET_ESP32
        default 4 if IDF_TARGET_ESP32S2 || IDF_TARGET_ESP32S3
        default 4 if IDF_TARGET_ESP32C3 || IDF_TARGET_ESP32C2
        help
            GPIO pin for interval cycle button.
            Press to cycle through interval values (5s → 30s → 1m → 10m → 30m → 60m).
            ESP32: Any GPIO (avoid 6-11, 34-39)
            Recommended: GPIO 0, 4, 5, 12-15, 25-27, 32-33

    config BUTTON_DEBOUNCE_TIME_MS
        int "Button debounce time (milliseconds)"
        range 10 500
        default 50
        help
            Debounce time for button press detection.
            Prevents false triggering from mechanical bounce.
            Typical values: 20-100ms
            Default: 50ms

endmenu
```

## firmware/ESP32/components/coap_handler/Kconfig
```kconfig
#TODO: WILL ENABLE IN THE FUTURE

menu "CoAP Handler Configuration"

    config ENABLE_COAP
        bool "Enable CoAP Protocol Support"
        default n
        help
            Enable CoAP client for lightweight IoT communication.
            CoAP uses UDP with minimal overhead (5KB memory vs 20KB for MQTT).
            Ideal for sensor data streaming alongside MQTT control messages.

    config COAP_SERVER_IP
        string "CoAP Server IP Address"
        default "192.168.1.100"
        depends on ENABLE_COAP
        help
            IP address of your CoAP server (web server).
            Example: 192.168.1.100 (same as your web server)

    config COAP_SERVER_PORT
        int "CoAP Server Port"
        range 1 65535
        default 5683
        depends on ENABLE_COAP
        help
            UDP port of CoAP server.
            RFC 7252 standard: 5683
            DTLS secure: 5684 (if supported)

    config COAP_ENABLE_DTLS
        bool "Enable DTLS Security (Optional)"
        default n
        depends on ENABLE_COAP
        help
            Enable DTLS for encrypted CoAP communication.
            Requires additional libraries and memory.
            Not needed for local network testing.

endmenu
```

## firmware/ESP32/components/mqtt_handler/Kconfig
```kconfig
menu "MQTT Protocol Configuration"

    config ENABLE_MQTT
        bool "Enable MQTT Protocol"
        default y
        help
            Enable MQTT protocol for IoT communication

    config BROKER_URL
        string "MQTT Broker URL"
        default "mqtt://test.mosquitto.org"
        depends on ENABLE_MQTT
        help
            URL of the MQTT broker to connect to.
            Examples:
            - mqtt://mqtt.eclipseprojects.io
            - mqtt://broker.hivemq.com
            - mqtt://test.mosquitto.org

    config MQTT_CLIENT_ID
        string "MQTT Client ID"
        default "ESP32_DataLogger"
        depends on ENABLE_MQTT
        help
            Unique client ID for MQTT connection.
            Leave blank to auto-generate from MAC address.

    config MQTT_USERNAME
        string "MQTT Username"
        default "DataLogger"
        depends on ENABLE_MQTT
        help
            Username for MQTT broker authentication

    config MQTT_PASSWORD
        string "MQTT Password"
        default "datalogger"
        depends on ENABLE_MQTT
        help
            Password for MQTT broker authentication

endmenu
```

## firmware/ESP32/components/relay_control/Kconfig
```kconfig
menu "Relay Control Configuration"

    config RELAY_GPIO_NUM
        int "Relay control GPIO pin number"
        range 0 39 if IDF_TARGET_ESP32
        range 0 46 if IDF_TARGET_ESP32S2
        range 0 48 if IDF_TARGET_ESP32S3
        range 0 21 if IDF_TARGET_ESP32C3 || IDF_TARGET_ESP32C2
        default 18 if IDF_TARGET_ESP32
        default 18 if IDF_TARGET_ESP32S2 || IDF_TARGET_ESP32S3
        default 8 if IDF_TARGET_ESP32C3 || IDF_TARGET_ESP32C2
        help
            GPIO number for relay control output.
            Connect this to relay module input.
            ESP32: Any GPIO except input-only pins (34-39)
            Recommended: GPIO 18, 19, 21, 22, 23

endmenu
```

## firmware/ESP32/components/stm32_uart/Kconfig
```kconfig
menu "STM32 Communication (UART)"

    config MQTT_UART_PORT_NUM
        int "UART port number for STM32 communication"
        range 0 2 if IDF_TARGET_ESP32 || IDF_TARGET_ESP32S3
        default 2 if IDF_TARGET_ESP32 || IDF_TARGET_ESP32S3
        range 0 1
        default 1
        help
            UART port number for communicating with STM32.
            This is separate from UART0 (console) to avoid mixing logs.
            UART0: Console/Debug logs
            UART1/UART2: STM32 communication

    config MQTT_UART_BAUD_RATE
        int "STM32 UART communication speed"
        range 9600 921600
        default 115200
        help
            UART communication speed for STM32 communication.
            Must match STM32 UART configuration.
            Common values: 9600, 19200, 38400, 57600, 115200, 230400, 460800, 921600

    config MQTT_UART_TXD
        int "STM32 UART TXD pin number"
        range 0 39 if IDF_TARGET_ESP32
        range 0 46 if IDF_TARGET_ESP32S2
        range 0 48 if IDF_TARGET_ESP32S3
        range 0 21 if IDF_TARGET_ESP32C3 || IDF_TARGET_ESP32C2
        default 17 if IDF_TARGET_ESP32
        default 17 if IDF_TARGET_ESP32S2 || IDF_TARGET_ESP32S3
        default 7 if IDF_TARGET_ESP32C3 || IDF_TARGET_ESP32C2
        help
            GPIO number for STM32 UART TX pin.
            Connect this to STM32 RX pin.
            ESP32: Any GPIO except input-only pins (34-39)
            Recommended: GPIO 16, 17, 25, 26, 27

    config MQTT_UART_RXD
        int "STM32 UART RXD pin number"
        range 0 39 if IDF_TARGET_ESP32
        range 0 46 if IDF_TARGET_ESP32S2
        range 0 48 if IDF_TARGET_ESP32S3
        range 0 21 if IDF_TARGET_ESP32C3 || IDF_TARGET_ESP32C2
        default 16 if IDF_TARGET_ESP32
        default 16 if IDF_TARGET_ESP32S2 || IDF_TARGET_ESP32S3
        default 6 if IDF_TARGET_ESP32C3 || IDF_TARGET_ESP32C2
        help
            GPIO number for STM32 UART RX pin.
            Connect this to STM32 TX pin.
            ESP32: Any GPIO
            Recommended: GPIO 16, 17, 25, 26, 27

endmenu
```

## firmware/ESP32/components/wifi_manager/Kconfig
```kconfig
menu "Status LED Configuration"

    config WIFI_LED_GPIO
        int "WiFi status LED GPIO pin number"
        range 0 39 if IDF_TARGET_ESP32
        range 0 46 if IDF_TARGET_ESP32S2
        range 0 48 if IDF_TARGET_ESP32S3
        range 0 21 if IDF_TARGET_ESP32C3 || IDF_TARGET_ESP32C2
        default 22 if IDF_TARGET_ESP32
        default 22 if IDF_TARGET_ESP32S2 || IDF_TARGET_ESP32S3
        default 8 if IDF_TARGET_ESP32C3 || IDF_TARGET_ESP32C2
        help
            GPIO pin for WiFi connection status LED.
            LED ON: WiFi connected
            LED OFF: WiFi disconnected
            ESP32: Any GPIO except input-only pins (34-39)
            Recommended: GPIO 2, 4, 5, 12-15, 18, 19, 21-23, 25-27, 32-33

    config MQTT_LED_GPIO
        int "MQTT status LED GPIO pin number"
        range 0 39 if IDF_TARGET_ESP32
        range 0 46 if IDF_TARGET_ESP32S2
        range 0 48 if IDF_TARGET_ESP32S3
        range 0 21 if IDF_TARGET_ESP32C3 || IDF_TARGET_ESP32C2
        default 23 if IDF_TARGET_ESP32
        default 23 if IDF_TARGET_ESP32S2 || IDF_TARGET_ESP32S3
        default 9 if IDF_TARGET_ESP32C3 || IDF_TARGET_ESP32C2
        help
            GPIO pin for MQTT connection status LED.
            LED ON: MQTT broker connected
            LED OFF: MQTT broker disconnected
            ESP32: Any GPIO except input-only pins (34-39)
            Recommended: GPIO 2, 4, 5, 12-15, 18, 19, 21-23, 25-27, 32-33

    config LED_ACTIVE_LEVEL
        int "LED active level (0=active low, 1=active high)"
        range 0 1
        default 1
        help
            Configure LED polarity:
            0: Active LOW (LED on when GPIO = 0, common cathode)
            1: Active HIGH (LED on when GPIO = 1, common anode)
            Default: Active HIGH (1)

endmenu
```

## firmware/ESP32/components/wifi_manager/Kconfig.projbuild
```kconfig
menu "WiFi Connection Configuration"

    config WIFI_SSID
        string "WiFi SSID"
        default "myssid"
        help
            SSID (network name) for WiFi connection.
            Enter your WiFi network name here.

    config WIFI_PASSWORD
        string "WiFi Password"
        default "mypassword"
        help
            WiFi password (WPA or WPA2) for the network.
            Leave blank if the network has no security.

    config WIFI_MAXIMUM_RETRY
        int "Maximum WiFi Retry Attempts"
        range 1 100
        default 5
        help
            Maximum number of retry attempts to connect to WiFi.
            Set this to avoid unlimited reconnection attempts.

    config WIFI_SCAN_METHOD
        int "WiFi Scan Method"
        range 0 1
        default 0
        help
            WiFi scan method:
            0 = Fast scan (stop after finding SSID)
            1 = All channel scan (scan all channels)

    config WIFI_CONNECT_AP_SORT_METHOD
        int "WiFi AP Sort Method"
        range 0 1
        default 0
        help
            Sort method when multiple APs are found:
            0 = Sort by signal strength (RSSI)
            1 = Sort by security mode

    config WIFI_SCAN_RSSI_THRESHOLD
        int "WiFi Minimum RSSI"
        range -127 0
        default -127
        help
            Minimum RSSI (signal strength) to accept.
            -127 = accept all signal strengths

    choice WIFI_SCAN_AUTH_MODE_THRESHOLD
        prompt "WiFi Security Mode Threshold"
        default WIFI_AUTH_WPA2_PSK
        help
            Minimum security mode to accept when scanning.

        config WIFI_AUTH_OPEN
            bool "OPEN (No Security)"
        config WIFI_AUTH_WEP
            bool "WEP"
        config WIFI_AUTH_WPA_PSK
            bool "WPA PSK"
        config WIFI_AUTH_WPA2_PSK
            bool "WPA2 PSK"
        config WIFI_AUTH_WPA_WPA2_PSK
            bool "WPA/WPA2 PSK"
        config WIFI_AUTH_WPA3_PSK
            bool "WPA3 PSK"
        config WIFI_AUTH_WPA2_WPA3_PSK
            bool "WPA2/WPA3 PSK"
    endchoice

    config WIFI_LISTEN_INTERVAL
        int "WiFi Listen Interval"
        range 0 100
        default 3
        help
            Interval for station to listen to beacon from AP.
            The unit is one beacon interval.
            For example: beacon interval = 100ms, listen interval = 3
            means station listens every 300ms.

    config WIFI_POWER_SAVE
        bool "Enable WiFi Power Save Mode"
        default y
        help
            Enable WiFi power save mode to reduce power consumption.

    choice WIFI_POWER_SAVE_MODE
        prompt "WiFi Power Save Mode"
        default WIFI_POWER_SAVE_MIN_MODEM
        depends on WIFI_POWER_SAVE
        help
            Select power save mode:
            - Minimum: Wake up every DTIM, broadcast data not lost
            - Maximum: Wake up every listen interval, may lose broadcast data

        config WIFI_POWER_SAVE_MIN_MODEM
            bool "Minimum Modem Power Saving"
        config WIFI_POWER_SAVE_MAX_MODEM
            bool "Maximum Modem Power Saving"
    endchoice

    config WIFI_ENABLE_IPV6
        bool "Enable IPv6"
        default y
        help
            Enable IPv6 support for WiFi connection.

    choice WIFI_IPV6_ADDR_TYPE
        prompt "Preferred IPv6 Address Type"
        default WIFI_IPV6_LOCAL_LINK
        depends on WIFI_ENABLE_IPV6
        help
            Select which IPv6 address type to wait for.

        config WIFI_IPV6_LOCAL_LINK
            bool "Local Link Address"
        config WIFI_IPV6_GLOBAL
            bool "Global Address"
        config WIFI_IPV6_SITE_LOCAL
            bool "Site Local Address"
        config WIFI_IPV6_UNIQUE_LOCAL
            bool "Unique Local Address"
    endchoice

    config WIFI_CONNECTION_TIMEOUT_MS
        int "WiFi Connection Timeout (ms)"
        range 5000 60000
        default 10000
        help
            Timeout for WiFi connection in milliseconds.

endmenu
```

## firmware/ESP32/main/Kconfig.projbuild
```kconfig
menu "IoT Protocol Configuration"

    # MQTT Configuration
    rsource "../components/mqtt_handler/Kconfig"

    # CoAP Configuration
    rsource "../components/coap_handler/Kconfig"

endmenu

menu "Hardware Pin Configuration"

    # STM32 UART Configuration
    rsource "../components/stm32_uart/Kconfig"

    # Relay Control Configuration
    rsource "../components/relay_control/Kconfig"

    # Button Handler Configuration
    rsource "../components/button_handler/Kconfig"

    # Status LED Configuration
    rsource "../components/wifi_manager/Kconfig"

endmenu
```

## firmware/ESP32/sdkconfig.defaults
```kconfig
# sdkconfig.defaults - Default configuration for ESP32 MQTT5 Client

# Enable MQTT
CONFIG_MQTT_PROTOCOL_311=y
CONFIG_MQTT_PROTOCOL_5=y

# Enable WiFi
CONFIG_ESP32_WIFI_SW_COEXIST_ENABLE=y
CONFIG_ESP32_WIFI_STATIC_RX_BUFFER_NUM=10
CONFIG_ESP32_WIFI_DYNAMIC_RX_BUFFER_NUM=32
CONFIG_ESP32_WIFI_STATIC_TX_BUFFER_NUM=0
CONFIG_ESP32_WIFI_DYNAMIC_TX_BUFFER_NUM=32

# Network settings
CONFIG_LWIP_SO_REUSE=y
CONFIG_LWIP_SO_REUSE_RXTOALL=y

# FreeRTOS settings
CONFIG_FREERTOS_HZ=1000
CONFIG_FREERTOS_TIMER_TASK_STACK_DEPTH=3072

# Main task settings
CONFIG_ESP_MAIN_TASK_STACK_SIZE=8192
CONFIG_ESP_MAIN_TASK_AFFINITY_CPU0=y

# Memory settings
CONFIG_ESP_SYSTEM_EVENT_TASK_STACK_SIZE=4096
CONFIG_MQTT_TASK_STACK_SIZE=6144

# Log settings
CONFIG_LOG_DEFAULT_LEVEL_INFO=y
CONFIG_LOG_DEFAULT_LEVEL=3

# Remove JSON dependency - using simple string parsing
```
